## config/west.yml
```yaml
manifest:
  remotes:
    - name: zmkfirmware
      url-base: https://github.com/zmkfirmware
    - name: nguyenleccss361
      url-base: https://github.com/nguyenleccss361
  projects:
    - name: zmk
      remote: nguyenleccss361
      revision: feature/sleep-countdown-widget
      import: app/west.yml
  self:
    path: config
```
